## main/Kconfig.projbuild
```kconfig
menu "Desk AI"

    config ESP_WIFI_SSID
        string "WiFi SSID"
        default "your_ssid"
        help
            SSID of the AP to connect to.

    config ESP_WIFI_PASSWORD
        string "WiFi Password"
        default "your_password"
        help
            Password of the AP.

    config BACKEND_URL
        string "Backend URL (POST)"
        default "http://192.168.4.1:5001/chat"
        help
            URL of the backend server (e.g. http://PC_IP:5001/chat). Use 5001 to avoid macOS AirPlay on 5000.

endmenu
```

## sdkconfig.defaults
```kconfig
# 启用 8MB PSRAM，供录音缓冲等大块内存使用（heap_caps_malloc MALLOC_CAP_SPIRAM）
CONFIG_SPIRAM=y
CONFIG_SPIRAM_MODE_OCT=y
CONFIG_SPIRAM_SPEED_80M=y
CONFIG_SPIRAM_USE_CAPS_ALLOC=y
```
